## adapters/esp_idf/portable_sdk/Kconfig
```kconfig
menu "Portable DSP SDK"
choice PORTABLE_SDK_FFT_CAPACITY
    prompt "Maximum supported FFT samples per channel"
    default PORTABLE_SDK_FFT_CAPACITY_4096
config PORTABLE_SDK_FFT_CAPACITY_512
    bool "512"
config PORTABLE_SDK_FFT_CAPACITY_1024
    bool "1024"
config PORTABLE_SDK_FFT_CAPACITY_2048
    bool "2048"
config PORTABLE_SDK_FFT_CAPACITY_4096
    bool "4096"
endchoice
config PORTABLE_SDK_MAX_FFT_SIZE
    int
    default 512 if PORTABLE_SDK_FFT_CAPACITY_512
    default 1024 if PORTABLE_SDK_FFT_CAPACITY_1024
    default 2048 if PORTABLE_SDK_FFT_CAPACITY_2048
    default 4096
endmenu
```

## examples/esp32_resampler_benchmark/sdkconfig.defaults
```kconfig
CONFIG_COMPILER_OPTIMIZATION_PERF=y
CONFIG_ESP_MAIN_TASK_STACK_SIZE=16384
CONFIG_ESP_DEFAULT_CPU_FREQ_MHZ_160=y
CONFIG_COMPILER_CXX_RTTI=y
```

## examples/esp32_streamer/main/Kconfig.projbuild
```kconfig
menu "Portable stream example"
choice STREAMER_LINK
    prompt "Host transport"
    default STREAMER_UART
config STREAMER_UART
    bool "UART (same BDSP packets as TCP)"
config STREAMER_TCP
    bool "TCP (firmware supplies accepted socket and WiFi setup)"
endchoice
config STREAMER_SPECTRAL
    bool "Mono Window -> Hann -> FFT -> Mel 8"
    default n
config STREAMER_SAMPLE_RATE
    int "Source sample rate (samples per second)"
    range 8000 192000
    default 8000
config STREAMER_ANALYSIS_RATE_NUMERATOR
    int "Analysis rate numerator (results per second)"
    range 1 1000
    default 120
config STREAMER_ANALYSIS_RATE_DENOMINATOR
    int "Analysis rate denominator"
    range 1 60000
    default 1
choice STREAMER_FFT_WINDOW
    prompt "Active FFT window samples per channel"
    default STREAMER_FFT_2048
    depends on STREAMER_SPECTRAL
config STREAMER_FFT_512
    bool "512"
config STREAMER_FFT_1024
    bool "1024"
    depends on PORTABLE_SDK_MAX_FFT_SIZE >= 1024
config STREAMER_FFT_2048
    bool "2048"
    depends on PORTABLE_SDK_MAX_FFT_SIZE >= 2048
config STREAMER_FFT_4096
    bool "4096"
    depends on PORTABLE_SDK_MAX_FFT_SIZE >= 4096
endchoice
config STREAMER_FFT_SIZE
    int
    default 512 if STREAMER_FFT_512
    default 1024 if STREAMER_FFT_1024
    default 4096 if STREAMER_FFT_4096
    default 2048 if PORTABLE_SDK_MAX_FFT_SIZE >= 2048
    default PORTABLE_SDK_MAX_FFT_SIZE
config STREAMER_MEMORY_KIB
    int "Explicit DSP/source/control/adapter memory budget (KiB)"
    range 64 16384
    default 320
config STREAMER_CONTROL_WIRE_KIB
    int "Complete canonical CONTROL message limit (KiB)"
    range 4 96
    default 4
config STREAMER_CONTROL_ARENA_KIB
    int "Canonical CONTROL decode arena (KiB)"
    range 8 64
    default 8
config STREAMER_EXTERNAL_PCM
    bool "Use explicit host I2S/Bluetooth PCM hook instead of synthetic tones"
    default n
config STREAMER_UART_TX
    int "UART1 TX pin"
    default 17
config STREAMER_UART_RX
    int "UART1 RX pin"
    default 16
config STREAMER_UART_BAUD
    int "UART 8N1 baud (raw profile needs conservative wire budget)"
    range 115200 4000000
    default 2000000
config STREAMER_TCP_BUDGET
    int "Explicit TCP bytes per second budget"
    range 1 10000000
    default 200000
endmenu
```

## examples/esp32_streamer/sdkconfig.defaults
```kconfig
CONFIG_IDF_TARGET="esp32"
CONFIG_COMPILER_CXX_EXCEPTIONS=n
CONFIG_COMPILER_CXX_RTTI=n
CONFIG_FREERTOS_SUPPORT_STATIC_ALLOCATION=y
```
